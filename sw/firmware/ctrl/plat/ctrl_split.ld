/* SPDX-FileCopyrightText: 2026 Kebag Logic */
/* SPDX-License-Identifier: CERN-OHL-W-2.0 */
/* ctrl_split.ld - the control firmware in the split placement's block RAM
 * (#640 M8a). The firmware owns the reset entry: _start is the first word of
 * rom, the CPU's reset address. rom holds the load image (.text, .rodata and
 * the initial values of .data); sram holds .data, .bss and the stack.
 * regions.ld is sw/litex/ctrl_memory.py's, the one statement of the map, and
 * the SoC sizes both regions' block RAM from the image this script links. */
OUTPUT_ARCH(riscv)
ENTRY(_start)
INCLUDE regions.ld

SECTIONS
{
	.text :
	{
		KEEP(*(.text.start))
		/* The service loop's hot code (#665, NFR-SCOUT-01): each function a
		 * service pass runs in the composed backlog windows, in the order a
		 * pass first runs it, ahead of the rest. The passes run some 46 KB of
		 * code through the 4 KiB direct-mapped fetch L1; in their own order,
		 * the functions a pass runs one after another take consecutive cache
		 * sets, so it refills fewer lines (docs/design/SPLIT_CONTROL_MEMORY.md
		 * section 11). Objects are <index>-<stem>.o (ctrl_srp_image.py). A
		 * name that matches no section places nothing, so ctrl_hot.py
		 * refuses a split image whose map has no section for an entry, and
		 * a list that is not the order ctrl_split_hot.txt records. */
		_ctrl_hot_start = .;
		*-mbx.o(.text.mbx_irq_status)
		*-srp_mbx.o(.text.rx_order_ready)
		*-ctrl_loop.o(.text.ctrl_loop_service)
		*-mbx.o(.text.mbx_rx_take)
		*-adp_mbx.o(.text.on_poll)
		*-adp.o(.text.adp_poll)
		*-adp.o(.text.reject_reentry)
		*-acmp_mbx.o(.text.on_poll)
		*-acmp.o(.text.acmp_poll)
		*-acmp.o(.text.enter)
		*-maap_mbx.o(.text.poll)
		*-maap_mbx.o(.text.refresh_demand)
		*-acmp.o(.text.acmp_declaring)
		*-ctrl_mem.o(.text.memset)
		*-ctrl_app_srp.o(.text.source)
		*-ctrl_app_aecp.o(.text.source)
		*-ctrl_aecp_image.o(.text.source)
		*-maap.o(.text.maap_poll)
		*-maap.o(.text.enter)
		*-maap.o(.text.pump)
		*-maap_mbx.o(.text.declaring)
		*-aecp_mbx.o(.text.poll)
		*-aecp.o(.text.aecp_poll)
		*-aecp.o(.text.aecp_enter)
		*-aecp.o(.text.now)
		*-aecp_mbx.o(.text.now)
		*-mbx.o(.text.mbx_now_ms)
		*-aecp.o(.text.arm)
		*-aecp_mbx.o(.text.timer)
		*-ctrl_app_aecp.o(.text.deliver)
		*-aecp_nvm.o(.text.aecp_nvm_poll)
		*-srp_mbx.o(.text.poll)
		*-srp_mbx.o(.text.enter)
		*-mbx.o(.text.mbx_link_up)
		*-srp_mbx.o(.text.snapshot)
		*-srp_mbx.o(.text.capture)
		*-mrp_mad.o(.text.mrp_transmit)
		*-mrp_mad.o(.text.map_replay)
		*-ctrl_app_srp.o(.text.deliver)
		*-acmp.o(.text.acmp_listener_registered)
		*-ctrl_loop.o(.text.ctrl_loop_step)
		*-mbx_plat_mmio.o(.text.mbx_hal_wait)
		*-ctrl_loop.o(.text.ctrl_loop_run)
		*-ctrl_loop.o(.text.dispatch_ticks)
		*-mbx.o(.text.mbx_event_take)
		*-aecp_mbx.o(.text.ready)
		*-aecp.o(.text.aecp_ready)
		*-srp_mbx.o(.text.rx_ready)
		*-srp_mbx.o(.text.tick)
		*-timer.o(.text.shlan_timer_tick)
		*-nvm_store.o(.text.nvm_store_service)
		*-nvm_store.o(.text.nvm_now)
		*-nvm_flash_litespi.o(.text.ls_now_us)
		*-nvm_store.o(.text.nvm_any)
		*-nvm_store.o(.text.nvm_publish)
		*-adp_mbx.o(.text.on_event)
		*-acmp_mbx.o(.text.on_event)
		*-maap_mbx.o(.text.event)
		*-aecp_mbx.o(.text.event)
		*-srp_mbx.o(.text.on_event)
		*-adp.o(.text.adp_gm_change)
		*-adp.o(.text.enter_delay)
		*-adp_mbx.o(.text.port_timer_start)
		*-mbx.o(.text.mbx_timer_arm)
		*-acmp_mbx.o(.text.on_adp_frame)
		*-adp_mbx.o(.text.on_frame)
		*-adp.o(.text.adp_rx)
		*-acmp_mbx.o(.text.on_frame)
		*-acmp.o(.text.acmp_rx)
		*-acmp.o(.text.wire_be64)
		*-acmp.o(.text.wire_be32)
		*-acmp.o(.text.echo)
		*-ctrl_mem.o(.text.memcpy)
		*-ctrl_mem.o(.text.forward)
		*-acmp.o(.text.respond)
		*-acmp.o(.text.build)
		*-acmp.o(.text.wire_put_be)
		*libcompiler_rt.a:lshrdi3.o(.text.__lshrdi3)
		*-acmp.o(.text.transmit)
		*-acmp.o(.text.publish)
		*-acmp.o(.text.p_send)
		*-acmp_mbx.o(.text.port_send)
		*-mbx.o(.text.mbx_tx_send)
		*-acmp.o(.text.finish)
		*-acmp.o(.text.record_of)
		*-acmp.o(.text.view_of)
		*-aecp_mbx.o(.text.frame)
		*-aecp.o(.text.aecp_rx)
		*-aecp.o(.text.wire_be32)
		*-aecp.o(.text.wire_be64)
		*-aecp.o(.text.header)
		*-aecp.o(.text.put48)
		*-aecp.o(.text.put64)
		*-aecp_commands.o(.text.aecp_command)
		*-aecp_commands.o(.text.body)
		*-aecp_commands.o(.text.aecp_find)
		*-aecp.o(.text.aecp_port_begin)
		*-aecp_mbx.o(.text.available_index)
		*-ctrl_app_aecp.o(.text.available_index)
		*-aecp.o(.text.aecp_port_end)
		*-aecp_commands.o(.text.wire_put_be)
		*-maap_mbx.o(.text.receive)
		*-maap.o(.text.maap_rx)
		*-maap.o(.text.mac_at)
		*-maap.o(.text.enqueue)
		*-maap.o(.text.wire_put_be)
		*-maap_mbx.o(.text.send_frame)
		*-aecp.o(.text.send)
		*-aecp_mbx.o(.text.send)
		*-mbx_plat_mmio.o(.text.mbx_hal_read32)
		*-srp_mbx.o(.text.reset_interface)
		*-mbx.o(.text.mbx_rx_mark)
		*-srp_mbx.o(.text.publish_licence)
		*-mbx.o(.text.mbx_pub_licence)
		*-mbx.o(.text.mbx_pub_talker_decl)
		*-msrp.o(.text.msrp_app_destroy)
		*-mrp_mad.o(.text.mrp_app_destroy)
		*-timer.o(.text.shlan_timer_remove)
		*-shlan_port.o(.text.shlan_free)
		*-ctrl_pool.o(.text.ctrl_pool_free)
		*-mvrp.o(.text.mvrp_app_destroy)
		*-srp_mbx.o(.text.open_interface)
		*-msrp.o(.text.msrp_app_create)
		*-mrp_mad.o(.text.mrp_app_create)
		*-shlan_port.o(.text.shlan_calloc)
		*-ctrl_pool.o(.text.ctrl_pool_calloc)
		*-ctrl_pool.o(.text.ctrl_pool_alloc)
		*-timer.o(.text.shlan_timer_init)
		*-mrp_mad.o(.text.leaveall_draw)
		*-timer.o(.text.shlan_timer_arm)
		*-mvrp.o(.text.mvrp_app_create)
		*-mrp_mad.o(.text.mrp_set_observer)
		*-mrp_mad.o(.text.mrp_port_configure)
		*-mrp_mad.o(.text.mrp_set_rx_filter)
		*-mbx.o(.text.mbx_pub_domain)
		*-mrp_mad.o(.text.mrp_mad_join)
		*-mrp_mad.o(.text.get_or_create_attr)
		*-mrp_mad.o(.text.find_attr.isra.0)
		*-mrp_mad.o(.text.attr_store_len)
		*-msrp.o(.text.msrp_attr_mem_len)
		*-mrp_mad.o(.text.deliver_event_changed)
		*-mrp_mad.o(.text.reg_event)
		*-mrp_mad.o(.text.observe.isra.0)
		*-srp_mbx.o(.text.msrp_moved)
		*-mvrp.o(.text.mvrp_declare)
		*-mvrp.o(.text.mvrp_attr_len)
		*-srp_mbx.o(.text.mvrp_moved)
		*-srp_mbx.o(.text.declare_sources)
		*-msrp.o(.text.msrp_attr_cmp)
		*-ctrl_mem.o(.text.memcmp)
		*-mbx.o(.text.mbx_pub_idle_slope)
		*-mbx.o(.text.mbx_rx_before)
		*-mrp_mad.o(.text.mrp_attr_visit)
		*-srp_mbx.o(.text.registrations)
		*-mrp_mad.o(.text.mrp_reclaim)
		*-adp.o(.text.adp_link_change)
		*-adp.o(.text.timer_stop)
		*-adp_mbx.o(.text.port_timer_stop)
		*-mbx.o(.text.mbx_timer_cancel)
		*-maap.o(.text.maap_port_operational)
		*-maap.o(.text.stop_timer)
		*-maap_mbx.o(.text.cancel)
		*-maap.o(.text.publish)
		*-maap_mbx.o(.text.range)
		*-mbx.o(.text.mbx_filter_set_maap_range)
		*-mbx.o(.text.mbx_pub_da_gate)
		*-ctrl_aecp_image.o(.text.allocation)
		*-srp_mbx.o(.text.receive)
		*-aecp.o(.text.aecp_tx_complete)
		*-aecp.o(.text.wire_put_be)
		*-aecp_commands.o(.text.aecp_stream_read)
		*-aecp_mbx.o(.text.stream)
		*-ctrl_app_aecp.o(.text.stream)
		*-srp_mbx.o(.text.apply_receive)
		*-mrp_mad.o(.text.mrp_rx)
		*-mrp_pdu.o(.text.mrpdu_parse)
		*-mrp_pdu.o(.text.parse_pass)
		*-msrp.o(.text.msrp_attr_len)
		*-msrp.o(.text.msrp_attr_has_subtype)
		*-msrp.o(.text.msrp_decode_attr)
		*-msrp.o(.text.increment_stream)
		*-mrp_mad.o(.text.rx_on_attr)
		*-srp_mbx.o(.text.interested_msrp)
		*-msrp.o(.text.msrp_join_ind)
		*-srp_mbx.o(.text.listener)
		*-msrp.o(.text.msrp_map_join)
		*-mrp_mad.o(.text.mrp_attr_registered_ports)
		*-msrp.o(.text.all_ports_except)
		*-mrp_mad.o(.text.mrp_app_n_ports)
		*-acmp.o(.text.acmp_adp_rx)
		*-acmp_mbx.o(.text.port_gptp)
		*-mbx.o(.text.mbx_gm_id)
		*-acmp.o(.text.now)
		*-acmp_mbx.o(.text.port_now)
		*-acmp.o(.text.delay)
		*-acmp_mbx.o(.text.port_seed)
		*-acmp_mbx.o(.text.port_timer)
		*-ctrl_app_srp.o(.text.changed)
		*-ctrl_app_aecp.o(.text.acmp_changed)
		*-ctrl_aecp_image.o(.text.notice)
		*-acmp.o(.text.acmp_change_pending)
		*-aecp.o(.text.aecp_changed)
		_ctrl_hot_end = .;
		*(.text .text.*)
	} > rom
	.rodata : ALIGN(4) { *(.rodata .rodata.* .srodata .srodata.*) } > rom
	.data : ALIGN(4)
	{
		_fdata = .;
		*(.data .data.* .sdata .sdata.*) *(.got .got.plt)
		. = ALIGN(4);
		_edata = .;
	} > sram AT > rom
	_fdata_rom = LOADADDR(.data);
	.bss (NOLOAD) : ALIGN(4)
	{
		_fbss = .;
		*(.bss .bss.* .sbss .sbss.* COMMON)
		. = ALIGN(4);
		_ebss = .;
	} > sram
	.stack (NOLOAD) : ALIGN(16)
	{
		. += 8192;
		_stack_top = .;
	} > sram
	/DISCARD/ : { *(.comment) *(.note .note.*) *(.eh_frame .eh_frame.*) }
}
