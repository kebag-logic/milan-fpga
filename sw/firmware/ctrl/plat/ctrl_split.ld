/* SPDX-FileCopyrightText: 2026 Kebag Logic */
/* SPDX-License-Identifier: CERN-OHL-W-2.0 */
/* ctrl_split.ld - the control firmware in the split placement's block RAM
 * (#640 M8a). The firmware owns the reset entry: _start is the first word of
 * rom, the CPU's reset address. rom holds the load image (.text, .rodata and
 * the initial values of .data); sram holds .data, .bss and the stack.
 * regions.ld is sw/litex/ctrl_memory.py's, the one statement of the map, and
 * the SoC sizes both regions' block RAM from the image this script links. */
OUTPUT_ARCH(riscv)
ENTRY(_start)
INCLUDE regions.ld

SECTIONS
{
	.text :
	{
		KEEP(*(.text.start))
		/* The service loop's hot code (#665, NFR-SCOUT-01): each function a
		 * service pass runs in the windows ctrl_split_hot.txt records, the
		 * composed backlog's and the largest legal AECP command's, in the
		 * order a pass first runs it, ahead of the rest, less an entry some
		 * image the list serves does not link (ctrl_split_hot.txt). The passes
		 * run some 56 KB of code through the 4 KiB direct-mapped fetch L1; in
		 * their own order, the functions a pass runs one after another take
		 * consecutive cache sets, so it refills fewer lines
		 * (docs/design/SPLIT_CONTROL_MEMORY.md section 11). Objects are <index>-<stem>.o (ctrl_srp_image.py). A
		 * name that matches no section places nothing, so ctrl_hot.py
		 * refuses a split image whose map has no section for an entry, and
		 * a list that is not the order ctrl_split_hot.txt records. */
		_ctrl_hot_start = .;
		*-ctrl_app_aecp.o(.text.ctrl_app_aecp_store_words)
		*-ctrl_app_aecp.o(.text.publish_store)
		*-aecp_face.o(.text.aecp_face_status)
		*-ctrl_app_aecp.o(.text.deliver)
		*-aecp_face.o(.text.aecp_face_poll)
		*-ctrl_loop.o(.text.ctrl_loop_service)
		*-srp_mbx.o(.text.poll)
		*-srp_mbx.o(.text.enter)
		*-mbx.o(.text.mbx_link_up)
		*-srp_mbx.o(.text.snapshot)
		*-srp_mbx.o(.text.reclaim)
		*-ctrl_app_srp.o(.text.deliver)
		*-srp_mbx.o(.text.srp_mbx_gate)
		*-nvm_store.o(.text.nvm_store_clock)
		*-nvm_store.o(.text.nvm_now)
		*-nvm_flash_litespi.o(.text.ls_now_us)
		*-ctrl_loop.o(.text.round_of)
		*-aecp_mbx.o(.text.retry)
		*-aecp.o(.text.aecp_retry)
		*-aecp.o(.text.aecp_enter)
		*-aecp.o(.text.round_waits)
		*-aecp.o(.text.now)
		*-aecp_mbx.o(.text.now)
		*-mbx.o(.text.mbx_now_ms)
		*-aecp.o(.text.scan)
		*-aecp.o(.text.arm)
		*-aecp_mbx.o(.text.timer)
		*-nvm_store.o(.text.nvm_store_step)
		*-ctrl_loop.o(.text.ctrl_loop_step)
		*-mbx_plat_mmio.o(.text.mbx_hal_wait)
		*-ctrl_loop.o(.text.ctrl_loop_run)
		*-aecp_mbx.o(.text.retry_aged)
		*-aecp.o(.text.aecp_retry_aged)
		*-srp_mbx.o(.text.transmit_aged)
		*-ctrl_app_srp.o(.text.settle)
		*-mbx.o(.text.mbx_rx_mark)
		*-ctrl_loop.o(.text.dispatch_ticks)
		*-mbx.o(.text.mbx_event_take)
		*-ctrl_loop.o(.text.service_rx)
		*-aecp_mbx.o(.text.ready)
		*-aecp.o(.text.aecp_ready)
		*-mbx.o(.text.mbx_rx_take)
		*-acmp_mbx.o(.text.on_rx_ready)
		*-srp_mbx.o(.text.rx_ready)
		*-mbx.o(.text.mbx_rx_waiting)
		*-adp_mbx.o(.text.on_poll)
		*-adp.o(.text.adp_poll)
		*-adp.o(.text.reject_reentry)
		*-acmp_mbx.o(.text.on_poll)
		*-acmp.o(.text.acmp_poll)
		*-acmp.o(.text.enter)
		*-maap_mbx.o(.text.poll)
		*-maap_mbx.o(.text.refresh_demand)
		*-acmp.o(.text.acmp_declaring)
		*-ctrl_mem.o(.text.memset)
		*-ctrl_app_srp.o(.text.source)
		*-ctrl_app_aecp.o(.text.source)
		*-ctrl_aecp_image.o(.text.source)
		*-maap.o(.text.maap_poll)
		*-maap.o(.text.enter)
		*-maap.o(.text.pump)
		*-maap_mbx.o(.text.declaring)
		*-aecp_mbx.o(.text.poll)
		*-aecp.o(.text.aecp_poll)
		*-aecp.o(.text.transmit)
		*-aecp_nvm.o(.text.aecp_nvm_poll)
		*-nvm_store.o(.text.nvm_store_status)
		*-srp_mbx.o(.text.tick)
		*-timer.o(.text.shlan_timer_tick)
		*-mrp_mad.o(.text.mrp_port_status)
		*-nvm_store.o(.text.nvm_store_tick)
		*-adp_mbx.o(.text.on_event)
		*-acmp_mbx.o(.text.on_event)
		*-maap_mbx.o(.text.event)
		*-aecp_mbx.o(.text.event)
		*-ctrl_app_aecp.o(.text.face_event)
		*-srp_mbx.o(.text.on_event)
		*-nvm_store.o(.text.nvm_store_service)
		*-nvm_store.o(.text.nvm_publish)
		*-adp.o(.text.adp_gm_change)
		*-adp.o(.text.enter_delay)
		*-adp_mbx.o(.text.port_timer_start)
		*-mbx.o(.text.mbx_timer_arm)
		*-mbx.o(.text.rx_word)
		*-aecp_mbx.o(.text.frame)
		*-aecp.o(.text.aecp_rx)
		*-aecp.o(.text.wire_be32)
		*-aecp.o(.text.wire_be64)
		*-aecp.o(.text.header)
		*-aecp.o(.text.aecp_put48)
		*-aecp.o(.text.aecp_put32)
		*-aecp.o(.text.aecp_put64)
		*-aecp.o(.text.applied)
		*-aecp_mbx.o(.text.applied)
		*-ctrl_app_aecp.o(.text.applied)
		*-aecp_face.o(.text.applied)
		*-mbx.o(.text.mbx_face_busy)
		*-aecp_commands.o(.text.aecp_command)
		*-aecp_commands.o(.text.body)
		*-ctrl_mem.o(.text.memcpy)
		*-ctrl_mem.o(.text.forward)
		*-aecp_commands.o(.text.aecp_find)
		*-aecp.o(.text.aecp_port_begin)
		*-aecp_mbx.o(.text.available_index)
		*-ctrl_app_aecp.o(.text.available_index)
		*-aecp.o(.text.aecp_port_end)
		*-aecp.o(.text.finish)
		*-aecp_mbx.o(.text.send)
		*-mbx.o(.text.mbx_tx_send)
		*-mbx.o(.text.mbx_tx_begin)
		*-mbx.o(.text.mbx_tx_commit)
		*-aecp.o(.text.sent_frame)
		*-srp_mbx.o(.text.reset_interface)
		*-srp_mbx.o(.text.publish_licence)
		*-mbx.o(.text.mbx_pub_licence)
		*-mbx.o(.text.mbx_pub_talker_decl)
		*-msrp.o(.text.msrp_app_destroy)
		*-mrp_mad.o(.text.mrp_app_destroy)
		*-timer.o(.text.shlan_timer_remove)
		*-shlan_port.o(.text.shlan_free)
		*-ctrl_pool.o(.text.ctrl_pool_free)
		*-mvrp.o(.text.mvrp_app_destroy)
		*-srp_mbx.o(.text.capture)
		*-mbx.o(.text.mbx_rx_before)
		*-adp.o(.text.adp_link_change)
		*-adp.o(.text.timer_stop)
		*-adp_mbx.o(.text.port_timer_stop)
		*-mbx.o(.text.mbx_timer_cancel)
		*-maap.o(.text.maap_port_operational)
		*-maap.o(.text.stop_timer)
		*-maap_mbx.o(.text.cancel)
		*-maap.o(.text.publish)
		*-maap_mbx.o(.text.range)
		*-mbx.o(.text.mbx_filter_set_maap_range)
		*-mbx.o(.text.mbx_pub_da_gate)
		*-ctrl_aecp_image.o(.text.allocation)
		*-srp_mbx.o(.text.open_interface)
		*-msrp.o(.text.msrp_app_create)
		*-mrp_mad.o(.text.mrp_app_create)
		*-shlan_port.o(.text.shlan_calloc)
		*-ctrl_pool.o(.text.ctrl_pool_calloc)
		*-ctrl_pool.o(.text.ctrl_pool_alloc)
		*-timer.o(.text.shlan_timer_init)
		*-mrp_mad.o(.text.leaveall_draw)
		*-timer.o(.text.shlan_timer_arm)
		*-mvrp.o(.text.mvrp_app_create)
		*-mrp_mad.o(.text.mrp_set_observer)
		*-mrp_mad.o(.text.mrp_port_configure)
		*-mrp_mad.o(.text.mrp_set_rx_filter)
		*-mbx.o(.text.mbx_pub_domain)
		*-mrp_mad.o(.text.mrp_mad_join)
		*-mrp_mad.o(.text.get_or_create_attr)
		*-mrp_mad.o(.text.attr_store_len)
		*-msrp.o(.text.msrp_attr_mem_len)
		*-mrp_mad.o(.text.deliver_event_changed)
		*-mrp_mad.o(.text.reg_event)
		*-mrp_mad.o(.text.observe.isra.0)
		*-srp_mbx.o(.text.moved_msrp)
		*-srp_mbx.o(.text.moved)
		*-mvrp.o(.text.mvrp_declare)
		*-mvrp.o(.text.mvrp_attr_len)
		*-srp_mbx.o(.text.moved_mvrp)
		*-srp_mbx.o(.text.declare_sources)
		*-srp_mbx.o(.text.wire_put_be)
		*-mbx.o(.text.mbx_pub_idle_slope)
		*-srp_mbx.o(.text.hold)
		*-mrp_mad.o(.text.mrp_attr_visit)
		*-srp_mbx.o(.text.registrations)
		*-mrp_mad.o(.text.mrp_reclaim)
		*-acmp_mbx.o(.text.on_frame)
		*-acmp.o(.text.acmp_rx)
		*-acmp.o(.text.wire_be64)
		*-acmp.o(.text.wire_be32)
		*-acmp.o(.text.echo)
		*-acmp.o(.text.respond)
		*-acmp.o(.text.build)
		*-acmp.o(.text.wire_put_be)
		*-acmp.o(.text.transmit)
		*-acmp.o(.text.publish)
		*-acmp.o(.text.p_send)
		*-acmp_mbx.o(.text.port_send)
		*-acmp.o(.text.finish)
		*-maap_mbx.o(.text.receive)
		*-maap.o(.text.maap_rx)
		*-maap.o(.text.mac_at)
		*-acmp_mbx.o(.text.on_adp_frame)
		*-adp_mbx.o(.text.on_frame)
		*-adp.o(.text.adp_rx)
		*-mbx.o(.text.mbx_tick_pending)
		*-srp_mbx.o(.text.transmit)
		*-srp_mbx.o(.text.rx_charge)
		*-mbx.o(.text.mbx_rx_next_len)
		*-mbx.o(.text.mbx_rx_next_byte)
		*-srp_mbx.o(.text.receive)
		*-maap.o(.text.enqueue)
		*-maap.o(.text.wire_put_be)
		*-maap_mbx.o(.text.send_frame)
		*-acmp.o(.text.acmp_adp_rx)
		*-acmp.o(.text.mark)
		*-acmp_mbx.o(.text.port_gptp)
		*-mbx.o(.text.mbx_gm_id)
		*-acmp.o(.text.now)
		*-acmp_mbx.o(.text.port_now)
		*-acmp.o(.text.delay)
		*-acmp_mbx.o(.text.port_seed)
		*-acmp_mbx.o(.text.port_timer)
		*-acmp.o(.text.view_of)
		*-ctrl_app_srp.o(.text.changed)
		*-ctrl_app_aecp.o(.text.acmp_changed)
		*-ctrl_aecp_image.o(.text.notice)
		*-acmp.o(.text.acmp_change_pending)
		*-aecp.o(.text.aecp_changed)
		*-aecp_commands.o(.text.aecp_stream_read)
		*-aecp_commands.o(.text.observe)
		*-aecp_mbx.o(.text.stream)
		*-ctrl_app_aecp.o(.text.stream)
		*-aecp_face.o(.text.stream)
		*-aecp_face.o(.text.gsi)
		*-mbx.o(.text.mbx_win_read)
		*-mbx.o(.text.mbx_win_ask)
		*-srp_mbx.o(.text.apply_receive)
		*-shlan_port.o(.text.shlan_port_pool)
		*-mrp_mad.o(.text.mrp_rx)
		*-mrp_pdu.o(.text.mrpdu_parse)
		*-mrp_pdu.o(.text.parse_pass)
		*-msrp.o(.text.msrp_attr_len)
		*-msrp.o(.text.msrp_attr_has_subtype)
		*-msrp.o(.text.msrp_decode_attr)
		*-msrp.o(.text.increment_stream)
		*-mrp_mad.o(.text.rx_on_attr)
		*-srp_mbx.o(.text.interested_msrp)
		*-srp_mbx.o(.text.sources_of)
		*-srp_mbx.o(.text.same)
		*-msrp.o(.text.msrp_join_ind)
		*-srp_mbx.o(.text.listener)
		*-msrp.o(.text.msrp_attr_cmp)
		*-ctrl_mem.o(.text.memcmp)
		*-acmp.o(.text.acmp_listener_registered)
		*-aecp.o(.text.monitor)
		*-aecp_mbx.o(.text.random_value)
		*-ctrl_app_aecp.o(.text.random_value)
		*-aecp_face.o(.text.random_value)
		*-ctrl_aecp_image.o(.text.a_random)
		*-aecp_maps.o(.text.aecp_map_command)
		*-aecp_commands.o(.text.aecp_foreign_lock)
		*-aecp_commands.o(.text.aecp_other_lock)
		*-aecp.o(.text.aecp_put16)
		*-aecp_maps.o(.text.wire_be32)
		*-aecp_maps.o(.text.legal)
		*-aecp_maps.o(.text.mark)
		*-aecp_mbx.o(.text.edit)
		*-ctrl_app_aecp.o(.text.edit)
		*-aecp_face.o(.text.edit)
		*-aecp_face.o(.text.beat)
		*-aecp_face.o(.text.record)
		*-aecp_face.o(.text.wire_be32)
		*-aecp_commands.o(.text.aecp_note)
		*-aecp_mbx.o(.text.changed)
		*-ctrl_app_aecp.o(.text.changed)
		*-aecp_nvm.o(.text.aecp_nvm_changed)
		*-aecp_nvm.o(.text.mark)
		*-nvm_klj2.o(.text.nvm_rec_id_of)
		*-aecp_face.o(.text.changed)
		*-aecp_face.o(.text.publish)
		*-aecp_face.o(.text.current.isra.0)
		*-mbx.o(.text.mbx_face_write)
		*-mbx.o(.text.mbx_face_commit)
		*-aecp.o(.text.fan_out)
		*-nvm_store.o(.text.nvm_store_changed_id)
		*-nvm_klj2.o(.text.nvm_rec_id_known)
		*-nvm_store.o(.text.nvm_mark)
		*-nvm_store.o(.text.nvm_open_set)
		*-adp.o(.text.adp_timer_expired)
		*-adp.o(.text.advertise)
		*-adp.o(.text.send)
		*-adp.o(.text.adp_build)
		*-adp_mbx.o(.text.port_gptp)
		*-adp.o(.text.wire_put_be)
		*-adp_mbx.o(.text.port_send)
		_ctrl_hot_end = .;
		*(.text .text.*)
	} > rom
	.rodata : ALIGN(4) { *(.rodata .rodata.* .srodata .srodata.*) } > rom
	.data : ALIGN(4)
	{
		_fdata = .;
		*(.data .data.* .sdata .sdata.*) *(.got .got.plt)
		. = ALIGN(4);
		_edata = .;
	} > sram AT > rom
	_fdata_rom = LOADADDR(.data);
	.bss (NOLOAD) : ALIGN(4)
	{
		_fbss = .;
		*(.bss .bss.* .sbss .sbss.* COMMON)
		. = ALIGN(4);
		_ebss = .;
	} > sram
	.stack (NOLOAD) : ALIGN(16)
	{
		. += 8192;
		_stack_top = .;
	} > sram
	/DISCARD/ : { *(.comment) *(.note .note.*) *(.eh_frame .eh_frame.*) }
}
