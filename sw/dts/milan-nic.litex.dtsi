// SPDX-License-Identifier: (GPL-2.0 OR MIT)
/*
 * Milan TSN NIC (kl,dma-ether) overlay — GENERATED by sw/dts/milan_dt.py
 * from the litex-naxriscv IR. DO NOT EDIT BY HAND; edit the IR + regenerate.
 * Overlay onto the SoC base .dts (LiteX litex_json2dts_linux, or the Zynq tree).
 */

/ {
	milan_eth: ethernet@90000000 {
		compatible = "kl,dma-ether-0.9";
		status = "okay";

		reg = <0x90000000 0x00010000>,
		      <0xf0002800 0x0000001c>,
		      <0xf000281c 0x0000001c>,
		      <0xf0002838 0x0000001c>;
		reg-names = "csr", "dma-tx", "dma-rx", "dma-ts";

		interrupt-parent = <&intc0>;
		interrupts = <3>;
		interrupt-names = "csr";

		kl,txq-cnt = <4>;
		kl,rxq-cnt = <4>;
		kl,shaped-queues = <0 1>;

		local-mac-address = [00 1b c5 00 00 01];
		phy-mode = "rgmii-id";
		phy-handle = <&milan_phy>;
		phy-reset-gpios = <&gpio 0 1>;

		kl,ptp;
		kl,ptp-clock-hz = <125000000>;

		mdio {
			#address-cells = <1>;
			#size-cells = <0>;
			milan_phy: ethernet-phy@1 {
				reg = <1>;
			};
		};
	};
};
