// SPDX-License-Identifier: (GPL-2.0 OR MIT)
/*
 * Milan TSN NIC (kl,dma-ether) overlay — GENERATED by sw/dts/milan_dt.py
 * from the zynq7000 IR. DO NOT EDIT BY HAND; edit the IR + regenerate.
 * Overlay onto the SoC base .dts (LiteX litex_json2dts_linux, or the Zynq tree).
 */

/ {
	milan_eth: ethernet@43c00000 {
		compatible = "kl,dma-ether-0.9";
		status = "okay";

		reg = <0x43c00000 0x00010000>,
		      <0x40410000 0x00010000>,
		      <0x40410000 0x00010000>,
		      <0x40400000 0x00010000>;
		reg-names = "csr", "dma-tx", "dma-rx", "dma-ts";

		interrupt-parent = <&intc>;
		interrupts = <0 29 4>, <0 30 4>, <0 31 4>, <0 32 4>;
		interrupt-names = "tx-dma", "rx-dma", "ts-dma", "csr";

		kl,txq-cnt = <4>;
		kl,rxq-cnt = <4>;
		kl,shaped-queues = <0 1>;

		local-mac-address = [00 1b c5 00 00 01];
		phy-mode = "rgmii-id";
		phy-handle = <&milan_phy>;
		phy-reset-gpios = <&gpio 0 1>;

		kl,ptp;
		kl,ptp-clock-hz = <125000000>;

		mdio {
			#address-cells = <1>;
			#size-cells = <0>;
			milan_phy: ethernet-phy@1 {
				reg = <1>;
			};
		};
	};
};
